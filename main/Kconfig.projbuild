## main/Kconfig.projbuild
```kconfig
menu "Bridge Configuration"
    config MAX_BRIDGED_DEVICES
        int "Maximum number of bridged devices"
        default 10
        range 1 20
        help
            Maximum number of ESP8266 devices that can be bridged.
endmenu
```

## matter/sdkconfig.defaults
```kconfig
CONFIG_ESPTOOLPY_FLASHSIZE_4MB=y

#enable BT
CONFIG_BT_ENABLED=y
CONFIG_BT_NIMBLE_ENABLED=y

#disable BT connection reattempt
CONFIG_BT_NIMBLE_ENABLE_CONN_REATTEMPT=n

#enable lwip ipv6 autoconfig
CONFIG_LWIP_IPV6_AUTOCONFIG=y

# Use a custom partition table
CONFIG_PARTITION_TABLE_CUSTOM=y
CONFIG_PARTITION_TABLE_FILENAME="partitions.csv"

# Enable chip shell
CONFIG_ENABLE_CHIP_SHELL=y


# Bridge: allow multiple bridged devices
CONFIG_ESP_MATTER_MAX_DYNAMIC_ENDPOINT_COUNT=11

# CPU frequency: 80MHz to save power
CONFIG_ESP_DEFAULT_CPU_FREQ_MHZ=80

# Optimize for size
CONFIG_COMPILER_OPTIMIZATION_SIZE=y

# Reduce mbedTLS SSL buffers to save DRAM
CONFIG_MBEDTLS_SSL_IN_CONTENT_LEN=8192
CONFIG_MBEDTLS_SSL_OUT_CONTENT_LEN=2048
CONFIG_ESP_MATTER_AGGREGATOR_ENDPOINT_COUNT=1

#enable lwIP route hooks
CONFIG_LWIP_HOOK_IP6_ROUTE_DEFAULT=y
CONFIG_LWIP_HOOK_ND6_GET_GW_DEFAULT=y

# Button
CONFIG_BUTTON_PERIOD_TIME_MS=20
CONFIG_BUTTON_LONG_PRESS_TIME_MS=5000

# disable softap by default
CONFIG_ESP_WIFI_SOFTAP_SUPPORT=n

# Enable OTA Requestor
CONFIG_ENABLE_OTA_REQUESTOR=y

# Disable brownout detector to prevent reboots on USB power dip
CONFIG_BROWNOUT_DET=n

# Enable WebSocket support for /ws endpoint
CONFIG_HTTPD_WS_SUPPORT=y

# Enable HKDF in mbedtls
CONFIG_MBEDTLS_HKDF_C=y

# Increase LwIP IPv6 address number to 6 (MAX_FABRIC + 1)
# unique local addresses for fabrics(MAX_FABRIC), a link local address(1)
CONFIG_LWIP_IPV6_NUM_ADDRESSES=6
```

## sdkconfig.defaults
```kconfig
CONFIG_IDF_TARGET="esp32"
CONFIG_PARTITION_TABLE_TWO_OTA=y
CONFIG_MATTER_ENABLE_BLE_COMMISSIONING=y
CONFIG_MBEDTLS_SSL_PROTO_TLS1_2=y
```
